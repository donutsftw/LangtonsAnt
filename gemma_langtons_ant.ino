#include <TinyWireM.h>
#include <avr/power.h>
#include <avr/sleep.h>

#define BRIGHTNESS   5 // 0=min, 15=max
#define I2C_ADDR   0x70 // Edit if backpack A0/A1 jumpers set

#define DELAY 150             //Sets the time each generation is shown
#define SIZEX 8    //Sets the X axis size
#define SIZEY 8    //Sets the Y axis size

//how many ants: more is more interseting visually, and makes it harder to see the pattern
const byte numberOfAnts=1;
byte world[SIZEX][SIZEY][2];
//array of ants: each ant has an x-position, y-position, and current direction
//ants[ANT][0]: x-position
//ants[ANT][1]: y-position 
//ants[ANT][2]: current direction: 1 = +y, 2 = +x, 3 = -y, 4 = -x
byte ants[numberOfAnts][3];

// This table is necessary because we are not using the Adafruit backpack library but we're driving
// the display directly
static const uint8_t PROGMEM reorder[] = { // Column-reordering table
    0x00,0x40,0x20,0x60,0x10,0x50,0x30,0x70,0x08,0x48,0x28,0x68,0x18,0x58,0x38,0x78,
    0x04,0x44,0x24,0x64,0x14,0x54,0x34,0x74,0x0c,0x4c,0x2c,0x6c,0x1c,0x5c,0x3c,0x7c,
    0x02,0x42,0x22,0x62,0x12,0x52,0x32,0x72,0x0a,0x4a,0x2a,0x6a,0x1a,0x5a,0x3a,0x7a,
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    0x87,0xc7,0xa7,0xe7,0x97,0xd7,0xb7,0xf7,0x8f,0xcf,0xaf,0xef,0x9f,0xdf,0xbf,0xff };
 
void ledCmd(uint8_t x) { // Issue command to LED backback driver
  TinyWireM.beginTransmission(I2C_ADDR);
  TinyWireM.write(x);
  TinyWireM.endTransmission();
}
 
void clear(void) { // Clear display buffer
  TinyWireM.beginTransmission(I2C_ADDR);
  for(uint8_t i=0; i<17; i++) TinyWireM.write(0);
  TinyWireM.endTransmission();
}

void setup() {
  power_timer1_disable();    // Disable unused peripherals
  randomSeed(analogRead(2));
  power_adc_disable();       // to save power
  PCMSK |= _BV(PCINT1);      // Set change mask for pin 1
  TinyWireM.begin();         // I2C init
  clear();                   // Blank display
  ledCmd(0x21);              // Turn on oscillator
  ledCmd(0xE0 | BRIGHTNESS); // Set brightness
  ledCmd(0x81);              // Display on, no blink
}

void loop(){ 
  for(byte i=0; i < numberOfAnts; i++){
    boolean on = world[ants[i][0]][ants[i][1]][0];
    //flip the state of the led (on/off)
    world[ants[i][0]][ants[i][1]][1] = !on;
    //if the LED was on, turn the ant 90 degrees right
    if(on){
      ants[i][2] = (ants[i][2]%4) + 1;
    }
    //if the LED was off, turn the ant 90 degrees left
    else{
      ants[i][2] = ((ants[i][2]+2)%4)+1;           
    }
    //move the ant forward one unit
    switch(ants[i][2]){
        case 1:
          ants[i][1]=(ants[i][1]+1)%SIZEY;
          break;
        case 2:
          ants[i][0]=(ants[i][0]+1)%SIZEX;
          break;
        case 3:
          ants[i][1]=(ants[i][1]+SIZEY-1)%SIZEY;
          break;
        case 4:
          ants[i][0]=(ants[i][0]+SIZEX-1)%SIZEX;
          break;
        default:
          //should never happen...
          ants[i][1]=(ants[i][1]+1)%SIZEY;
          break;
      }
  }      
  TinyWireM.beginTransmission(I2C_ADDR);
  TinyWireM.write(0);             // Start address
  for (uint8_t rowD = 0; rowD < 8; rowD++) { // 8 rows
    uint8_t cv = 0;
    for(uint8_t colD = 0; colD < 8; colD++) {    // 8 columns
      world[colD][rowD][0] = world[colD][rowD][1];
      cv |= ((world[colD][rowD][1] == 0) ? 0:1) << colD;
    }
    TinyWireM.write(pgm_read_byte(&reorder[cv]));
    TinyWireM.write(0);
  }
  TinyWireM.endTransmission();
  delay(DELAY);
}

void spawnAnts(){
  for(byte i=0; i < numberOfAnts; i++){
    //pick a random point and direction to start each ant
    //TODO: make sure ants are evenly distributed/can't spawn on top of each other
    ants[i][0] = random(0, SIZEX);
    ants[i][1] = random(0, SIZEY);
    ants[i][2] = random(1, 5);
  }
}


